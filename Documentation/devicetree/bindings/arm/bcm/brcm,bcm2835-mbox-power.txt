## Documentation/devicetree/bindings/arm/bcm/brcm,bcm2835-mbox-power.txt
```
Broadcom BCM2835 VideoCore mailbox power domain driver

Required properties:

- compatible:	Should be "brcm,bcm2835-mbox-power"
- mboxes:	Single-entry list which specifies which mailbox controller
		  and channel is the power channel.

Example:

mailbox-power {
	compatible = "brcm,bcm2835-mbox-power";
	mboxes = <&mailbox 0>
};
```

## Documentation/devicetree/bindings/arm/bcm/brcm,bcm2835-mbox-property.txt
```
Broadcom BCM2835 VideoCore mailbox property channel IPC

Required properties:

- compatible:	Should be "brcm,bcm2835-mbox-property"
- mboxes:	Single-entry list which specifies which mailbox controller
		  and channel is the property channel.

Example:

mailbox-property {
	compatible = "brcm,bcm2835-mbox-property";
	mboxes = <&mailbox 8>
};
```

## Documentation/devicetree/bindings/arm/bcm/raspberrypi,bcm2835-power.txt
```
Raspberry Pi power domain driver

Required properties:

- compatible:		Should be "raspberrypi,bcm2835-power".
- firmware:		Reference to the RPi firmware device node.
- #power-domain-cells:	Should be <1>, we providing multiple power domains.

The valid defines for power domain are:

 RPI_POWER_DOMAIN_USB

Example:

power: power {
	compatible = "raspberrypi,bcm2835-power";
	firmware = <&firmware>;
	#power-domain-cells = <1>;
};

Example for using power domain:

&usb {
       power-domains = <&power RPI_POWER_DOMAIN_USB>;
};
```

## Documentation/devicetree/bindings/clock/qcom,kryocc.txt
```
Qualcomm CPUSS clock controller for Kryo CPUs
----------------------------------------------------

Required properties :
- compatible : shall contain only one of the following:

			"qcom,msm8996-apcc"

- reg : shall contain base register location and length
- #clock-cells : shall contain 1

Example:
	kryocc: clock-controller@6400000 {
		compatible = "qcom,msm8996-apcc";
		reg = <0x6400000 0x90000>;
		#clock-cells = <1>;
	};
```
